## boards/esp32_c3_supermini/sdkconfig.defaults
```kconfig
CONFIG_ESPTOOLPY_FLASHSIZE_4MB=y
CONFIG_ESP_CONSOLE_USB_SERIAL_JTAG=y
CONFIG_BOOTLOADER_APP_ROLLBACK_ENABLE=y
```

## boards/esp32_s31_function_coreboard_1/sdkconfig.defaults
```kconfig
CONFIG_ESPTOOLPY_FLASHSIZE_16MB=y
CONFIG_SPIRAM=y
CONFIG_SPIRAM_MODE_OCT=y
CONFIG_SPIRAM_SPEED_200M=y
CONFIG_SPIRAM_BOOT_INIT=y
CONFIG_SPIRAM_USE_CAPS_ALLOC=y
CONFIG_ETH_EMAC_RGMII_TX_CLK_SRC_APLL=y
CONFIG_BOOTLOADER_APP_ROLLBACK_ENABLE=y
```

## boards/esp32s3_44pin_n16r8/sdkconfig.defaults
```kconfig
CONFIG_ESPTOOLPY_FLASHSIZE_16MB=y
CONFIG_SPIRAM=y
CONFIG_SPIRAM_MODE_OCT=y
CONFIG_SPIRAM_SPEED_80M=y
CONFIG_SPIRAM_BOOT_INIT=y
CONFIG_SPIRAM_USE_CAPS_ALLOC=y
CONFIG_BOOTLOADER_APP_ROLLBACK_ENABLE=y
```

## boards/m5stack_stamp_p4/sdkconfig.defaults
```kconfig
CONFIG_ESPTOOLPY_FLASHSIZE_16MB=y
CONFIG_ESP_CONSOLE_USB_SERIAL_JTAG=y
CONFIG_ESP32P4_SELECTS_REV_LESS_V3=y
CONFIG_ESP32P4_REV_MIN_100=y
CONFIG_SPIRAM=y
CONFIG_SPIRAM_MODE_HEX=y
CONFIG_SPIRAM_SPEED_200M=y
CONFIG_SPIRAM_BOOT_INIT=y
CONFIG_SPIRAM_USE_CAPS_ALLOC=y
CONFIG_BOOTLOADER_APP_ROLLBACK_ENABLE=y
```

## boards/xiao_esp32c5/sdkconfig.defaults
```kconfig
CONFIG_ESPTOOLPY_FLASHSIZE_8MB=y
CONFIG_ESP_CONSOLE_USB_SERIAL_JTAG=y
CONFIG_SPIRAM=y
CONFIG_SPIRAM_MODE_QUAD=y
CONFIG_SPIRAM_SPEED_40M=y
CONFIG_SPIRAM_BOOT_INIT=y
CONFIG_SPIRAM_USE_CAPS_ALLOC=y
CONFIG_BOOTLOADER_APP_ROLLBACK_ENABLE=y
```

## cmake/application/main/Kconfig.projbuild
```kconfig
menu "BlitzMax Thread features"

config BMX_THREAD_SRP_SERVER
    bool "Host a Thread SRP and DNS-SD server"
    depends on OPENTHREAD_ENABLED
    default n
    help
        Enable on-mesh service registration and discovery hosting. This does
        not enable border routing to Wi-Fi or Ethernet.

config BMX_THREAD_COAP
    bool "Enable OpenThread CoAP application API"
    depends on OPENTHREAD_ENABLED
    default n

config BMX_THREAD_COAP_BLOCK
    bool "Enable OpenThread CoAP blockwise transfers"
    depends on BMX_THREAD_COAP
    default n

config BMX_THREAD_COAP_OBSERVE
    bool "Enable OpenThread CoAP Observe"
    depends on BMX_THREAD_COAP
    default n

endmenu
```
